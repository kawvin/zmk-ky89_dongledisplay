## boards/shields/display-091-drum/Kconfig.shield
```kconfig
# Copyright (c) 2024 The ZMK Contributors
# SPDX-License-Identifier: MIT

config SHIELD_DISPLAY_091_DRUM
	def_bool $(shields_list_contains,display_091_drum)
```

## boards/shields/display-130-cat/Kconfig.shield
```kconfig
# Copyright (c) 2024 The ZMK Contributors
# SPDX-License-Identifier: MIT

config SHIELD_DISPLAY_130_CAT
	def_bool $(shields_list_contains,display_130_cat)
```

## boards/shields/ky89_dongle/Kconfig.defconfig
```kconfig
# Copyright (c) 2023 The ZMK Contributors
# SPDX-License-Identifier: MIT

if SHIELD_KY89_DONGLE_DONGLE || SHIELD_KY89_DONGLE_LEFT

config ZMK_SPLIT_ROLE_CENTRAL
    default y

config ZMK_KEYBOARD_NAME
    default "Ky89"

endif

if SHIELD_KY89_DONGLE_DONGLE || SHIELD_KY89_DONGLE_LEFT || SHIELD_KY89_DONGLE_RIGHT

config ZMK_SPLIT
    default y

choice BT_CTLR_TX_PWR
    default BT_CTLR_TX_PWR_PLUS_8
endchoice

endif



if SHIELD_KY89_DONGLE_LEFT || SHIELD_KY89_DONGLE_RIGHT

config ZMK_RGB_UNDERGLOW
    select WS2812_STRIP
    select SPI

endif

if SHIELD_KY89_DONGLE_DONGLE
if ZMK_DISPLAY

config SSD1306
    default y

config I2C
    default y

choice ZMK_DISPLAY_WORK_QUEUE
    default ZMK_DISPLAY_WORK_QUEUE_DEDICATED
endchoice


if LVGL

config LV_Z_VDB_SIZE
    default 64

config LV_DPI_DEF
    default 148

config LV_Z_BITS_PER_PIXEL
    default 1

choice LV_COLOR_DEPTH
    default LV_COLOR_DEPTH_1
endchoice

endif # LVGL

endif # ZMK_DISPLAY

endif
```

## boards/shields/ky89_dongle/Kconfig.shield
```kconfig
# Copyright (c) 2023 The ZMK Contributors
# SPDX-License-Identifier: MIT

config SHIELD_KY89_DONGLE_DONGLE
    def_bool $(shields_list_contains,ky89_dongle_dongle)

config SHIELD_KY89_DONGLE_LEFT
    def_bool $(shields_list_contains,ky89_dongle_left)

config SHIELD_KY89_DONGLE_RIGHT
    def_bool $(shields_list_contains,ky89_dongle_right)
```

## config/west.yml
```yaml
manifest:
  remotes:
    - name: zmkfirmware
      url-base: https://github.com/zmkfirmware
    # Additional modules containing boards/shields/custom code can be listed here as well
    # See https://docs.zephyrproject.org/3.2.0/develop/west/manifest.html#projects
    # 这里是添加dongle-display，https://github.com/englmaxi/zmk-dongle-display
    # - name: englmaxi
    #   url-base: https://github.com/englmaxi
    # - name: kawvin
    #   url-base: https://github.com/kawvin
    # - name: GarrettFaucher
    #   url-base: https://github.com/GarrettFaucher
  projects:
    - name: zmk
      remote: zmkfirmware
      revision: main
      import: app/west.yml
    # 这里是添加dongle-display，https://github.com/englmaxi/zmk-dongle-display
    # - name: zmk-dongle-display
    #   remote: englmaxi
    #   revision: main
    # - name: zmk-dongle-display-091-drum
    #   remote: kawvin
    #   revision: main
    # - name: zmk-dongle-display-091-oled
    #   remote: GarrettFaucher
    #   revision: main
  self:
    path: config
```
